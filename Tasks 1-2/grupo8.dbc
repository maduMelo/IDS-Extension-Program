VERSION ""

NS_ :

BS_:

BU_:

BO_ 12 velocidadeMotor: 16 Vector__XXX
	SG_ Velocidade_do_motor_signal : 31|16@1+ (0.25,0) [0|16384] "rpm" Vector__XXX

BO_ 13 temperaturaRefrigeradorMotor: 8 Vector__XXX
	SG_ Temperatura_refrigerador_Motor_s : 31|8@1+ (1,-40) [-40|215] "degC" Vector__XXX

BO_ 10 velocidadeCarro: 8 Vector__XXX
	SG_ Velocidade_Carro_signal : 31|8@1+ (1,0) [0|255] "km/h" Vector__XXX

BO_ 14 odometro: 32 Vector__XXX
	SG_ odometro : 31|32@1+ (0.1,0) [0|429496730] "km" Vector__XXX

BO_ 11 posicaoAcelerador: 8 Vector__XXX
	SG_ posicaoAcelerador : 31|8@1+ (0.392,0) [0|100] "%" Vector__XXX

BO_ 15 nivelTanque: 8 Vector__XXX
	SG_ nivelTanque : 31|8@1+ (0.392,0) [0|100] "%" Vector__XXX

BO_ 16 tanqueStatus: 16 Vector__XXX
	SG_ tanqueStatus : 0|0@1+ (0,0) [0|0] "" Vector__XXX

BO_ 17 temperaturaAmbiente: 8 Vector__XXX
	SG_ temperaturaAmbiente : 31|8@1+ (1,-40) [-40|215] "degC" Vector__XXX

CM_ BO_ 12 "Velocidade do motor";
CM_ SG_ 2015 Velocidade_do_motor_signal "Wheel-Based Vehicle Speed: Speed of the vehicle as calculated from wheel or tailshaft speed.";
CM_ BO_ 13 "Temperatura do resfriador";
CM_ BO_ 10 "Velocidade do Carro";
CM_ BO_ 14 "Kilometragem Percorrida";
CM_ BO_ 11 "Posição do Acelerador";
CM_ BO_ 15 "Nível do Tanque de Gasolina";
CM_ BO_ 16 "Status do Tanque";
CM_ BO_ 17 "Temperatura Ambiente";
BA_DEF_ SG_  "SPN" INT 0 524287;
BA_DEF_ BO_  "VFrameFormat" ENUM  "StandardCAN","ExtendedCAN","reserved","J1939PG";
BA_DEF_  "DatabaseVersion" STRING ;
BA_DEF_  "BusType" STRING ;
BA_DEF_  "ProtocolType" STRING ;
BA_DEF_  "DatabaseCompiler" STRING ;
BA_DEF_DEF_  "SPN" 0;
BA_DEF_DEF_  "VFrameFormat" "J1939PG";
BA_DEF_DEF_  "DatabaseVersion" "DEMO PLUS";
BA_DEF_DEF_  "BusType" "";
BA_DEF_DEF_  "ProtocolType" "";
BA_DEF_DEF_  "DatabaseCompiler" "";
BA_ "ProtocolType" "J1939";
BA_ "BusType" "CAN";
BA_ "DatabaseCompiler" "CSS ELECTRONICS (WWW.CSSELECTRONICS.COM)";
BA_ "DatabaseVersion" "1.0.0";
BA_ "SPN" SG_ 2566844926 WheelBasedVehicleSpeed 84;
